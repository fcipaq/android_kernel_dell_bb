## drivers/net/wireless/bcmdhd/Kconfig
```kconfig
config BCMDHD
	tristate "Broadcom FullMAC wireless cards support"
	---help---
	  This module adds support for wireless adapters based on
	  Broadcom FullMAC chipset.

	  If you choose to build a module, it'll be called dhd. Say M if
	  unsure.

config BCMDHD_SDIO
	bool "SDIO bus interface support"
	depends on BCMDHD && MMC

config BCMDHD_PCIE
	bool "PCIe bus interface support"
	depends on BCMDHD && PCI && !BCMDHD_SDIO

config BCM4354
	tristate "BCM4354 support"
	depends on BCMDHD

config BCM4339
    bool "Broadcom combo Wi-Fi 2.4G/5G chipset BCM4339"
    depends on BCMDHD
    ---help---
      Choose wifi chipset for ZE project

config BCM43455
    bool "Broadcom combo Wi-Fi 2.4G/5G chipset BCM43455"
    depends on BCMDHD
    ---help---
      Choose wifi chipset for ZE project

config BCMDHD_FW_PATH
	depends on BCMDHD
	string "Firmware path"
	default "/system/etc/firmware/fw_bcmdhd.bin"
	---help---
	  Path to the firmware file.

config BCMDHD_NVRAM_PATH
	depends on BCMDHD
	string "NVRAM path"
	default "/system/etc/wifi/bcmdhd.cal"
	---help---
	  Path to the calibration file.

config BCMDHD_DELL_CUSTOM_MAC
	depends on BCMDHD && BCMDHD_SDIO
	bool "Custom Wifi MAC address"
	default y
	---help---
	  Custom Wifi MAC address.
	  Set via kernel parameter custom_mac
	  e.g. bcmdhd.custom_mac=0123456789ab
	  will give 01:23:45:67:89:ab

config BCMDHD_DELL_CUSTOM_CCODE
	depends on BCMDHD
	bool "Custom country code"
	default y
	---help---
	  Custom Wifi MAC address.
	  Set via kernel parameter custom_ccode
	  e.g. bcmdhd.custom_ccode=US
	  Supported codes:
	    WW (world wide)
	    AE
	    BH
	    CN
	    CZ
	    DE
	    DK
	    ES
	    FR
	    FI
	    GB
	    HK
	    HU
	    ID
	    IL
	    IN
	    IT
	    IS
	    JP
	    MY
	    NL
	    NO
	    PT
	    RU
	    SA
	    SE
	    SG
	    TH
	    TR
	    TW
	    UA
	    US
	    VN

config BCMDHD_WEXT
	bool "Enable WEXT support"
	depends on BCMDHD && CFG80211 = n
	select WIRELESS_EXT
	select WEXT_PRIV
	help
	  Enables WEXT support

config DHD_USE_STATIC_BUF
	bool "Enable memory preallocation"
	depends on BCMDHD
	default n
	---help---
	  Use memory preallocated in platform

config DHD_USE_SCHED_SCAN
	bool "Use CFG80211 sched scan"
	depends on BCMDHD && CFG80211
	default n
	---help---
	  Use CFG80211 sched scan
```

## drivers/staging/imgtec/intel/Kconfig
```kconfig
config MOOREFIELD
	bool

config VIDEO_MRFLD
	bool

config VIDEO_MRFLD_EC
	bool

config DRM_MRFLD
	bool
	select MOOREFIELD
	select VIDEO_MRFLD
	select VIDEO_MRFLD_EC

config SLICE_HEADER_PARSING
	bool

config SUPPORT_HDMI
	bool "Support HDMI"

config DRM_INTEL_MID_FAKE
	bool
	select FB_CFB_COPYAREA
	select FB_CFB_FILLRECT
	select FB_CFB_IMAGEBLIT
	select DRM_KMS_HELPER
	select GENERIC_ALLOCATOR
	select DRM_TTM
	select SLICE_HEADER_PARSING
	select DRM_MRFLD
#	select SUPPORT_HDMI

menuconfig DRM_INTEL_MID
	bool "Intel MID platform graphics support"
	depends on POWERVR_ROGUE
	depends on X86_INTEL_MID
	depends on PCI
	select DRM_INTEL_MID_FAKE

config SUPPORT_MIPI
	bool "Enable MIPI interface"

config MDFD_DUAL_MIPI
	bool "Support two MIPI lines"
	depends on SUPPORT_MIPI

config MID_DSI_DSR
	bool "Support DSR (display self refresh)"
	depends on SUPPORT_MIPI

config AMOLED_SUPPORT
	bool "Enable AMOLED burn-in protection"
	depends on MOOREFIELD
	help
	  Shift the image on the screen by a small amount of pixels
	  to prevent image burn in on AMOLED displays.
	  Only for SDC 16x25 and SDC 25x16 on Dell Venue 7840/7040
	  (aka. Intel Blackburn/Eaglespeak)

#config PSB_ZOOM
#	bool "Support double scan"

source "drivers/staging/imgtec/intel/dfrgx/Kconfig"

source "drivers/staging/imgtec/intel/hdmi_audio/Kconfig"
```

## drivers/staging/imgtec/intel/dfrgx/Kconfig
```kconfig
config GFX_RGX_DEVFREQ
	tristate "DVFS support for PowerVR Rogue"
	depends on DRM_INTEL_MID
	depends on PM_DEVFREQ
	select DEVFREQ_GOV_SIMPLE_ONDEMAND
	select DEVFREQ_GOV_PERFORMANCE
	select DEVFREQ_GOV_POWERSAVE
	help
	  This adds the DEVFREQ driver for the Imagination Technologies
	  PowerVR graphics technology for the Intel MID platform family.
	  This driver helps control GPU clock speed in order to provide
	  high performance on demand and power savings when not busy or
	  when thermal conditions suggest.
```

## drivers/staging/imgtec/intel/hdmi_audio/Kconfig
```kconfig
config SUPPORT_HDMI
	depends on DRM_INTEL_MID
	bool

config INTEL_HDMI_AUDIO
	tristate "HDMI audio driver"
	depends on DRM_INTEL_MID
	select SUPPORT_HDMI
	help
	  Enables support for audio over HDMI.
```
